## PowerRune24-Armour/sdkconfig.defaults
```kconfig
#
# Serial flasher config
#
CONFIG_ESPTOOLPY_FLASH_MODE_AUTO_DETECT=y
CONFIG_ESPTOOLPY_FLASHSIZE_8MB=y
CONFIG_ESPTOOLPY_FLASHSIZE="8MB"
# end of Serial flasher config

#
# Partition Table
#
# CONFIG_PARTITION_TABLE_SINGLE_APP is not set
# CONFIG_PARTITION_TABLE_SINGLE_APP_LARGE is not set
# CONFIG_PARTITION_TABLE_TWO_OTA is not set
CONFIG_PARTITION_TABLE_CUSTOM=y
CONFIG_PARTITION_TABLE_CUSTOM_FILENAME="partitions_PRA.csv"
CONFIG_PARTITION_TABLE_FILENAME="partitions_PRA.csv"
CONFIG_PARTITION_TABLE_OFFSET=0x8000
CONFIG_PARTITION_TABLE_MD5=y
# end of Partition Table

#
# FreeRTOS
#


#
# Kernel
#
CONFIG_FREERTOS_HZ=1000

#
# LWIP
#
CONFIG_LWIP_LOCAL_HOSTNAME="PowerRune_Armour"
#
# OTA
#
CONFIG_APP_ROLLBACK_ENABLE=y
#
# COMPILER
#
# CONFIG_COMPILER_OPTIMIZATION_DEFAULT is not set
CONFIG_COMPILER_OPTIMIZATION_SIZE=y
# CONFIG_COMPILER_OPTIMIZATION_PERF is not set
# CONFIG_COMPILER_OPTIMIZATION_NONE is not set
#
# TLS
#
CONFIG_ESP_TLS_INSECURE=y
CONFIG_ESP_TLS_SKIP_SERVER_CERT_VERIFY=y
```

## PowerRune24-Common-C3/main/Kconfig.projbuild
```kconfig
menu "CAN lib Configuration"
##
    orsource "$IDF_PATH/examples/common_components/env_caps/$IDF_TARGET/Kconfig.env_caps"

    config CAN_TX_GPIO_NUM
        int "TX GPIO number"
        range ENV_GPIO_RANGE_MIN ENV_GPIO_OUT_RANGE_MAX
        default 21 if IDF_TARGET_ESP32
        default 4
        help
            This option selects the GPIO pin used for the TX signal. Connect the
            TX signal to your transceiver.

    config CAN_RX_GPIO_NUM
        int "RX GPIO number"
        range ENV_GPIO_RANGE_MIN ENV_GPIO_IN_RANGE_MAX
        default 22 if IDF_TARGET_ESP32
        default 5
        help
            This option selects the GPIO pin used for the RX signal. Connect the
            RX signal to your transceiver.

endmenu
```

## PowerRune24-Motor/main/Kconfig.projbuild
```kconfig
menu "CAN lib Configuration"
##
    orsource "$IDF_PATH/examples/common_components/env_caps/$IDF_TARGET/Kconfig.env_caps"

    config CAN_TX_GPIO_NUM
        int "TX GPIO number"
        range ENV_GPIO_RANGE_MIN ENV_GPIO_OUT_RANGE_MAX
        default 21 if IDF_TARGET_ESP32
        default 4
        help
            This option selects the GPIO pin used for the TX signal. Connect the
            TX signal to your transceiver.

    config CAN_RX_GPIO_NUM
        int "RX GPIO number"
        range ENV_GPIO_RANGE_MIN ENV_GPIO_IN_RANGE_MAX
        default 22 if IDF_TARGET_ESP32
        default 5
        help
            This option selects the GPIO pin used for the RX signal. Connect the
            RX signal to your transceiver.

    config DEFAULT_MOTOR_ID
        int "Default motor ID"
        default 1
        help
            This option selects the default motor ID.

    config DEFAULT_MOTOR_NORMAL_RPM
        int "Default motor RPM for mode 0"
        default 1140
        help
            This option selects the default motor ID.

endmenu
menu "PowerRune Project Configuration"

    orsource "$IDF_PATH/examples/common_components/env_caps/$IDF_TARGET/Kconfig.env_caps"

    config POWERRUNE_TYPE
        int "PowerRune Driver Board Type"
        default 2
        help
            PowerRune driver board type (0:ARMOUR, 1:RLOGO, 2:MOTORCTL)

    config DEFAULT_UPDATE_URL
        string "PowerRune Update Server Address"
        default "https://gitlab.seu.edu.cn/ch/pr-ota-bin/-/raw/main/"
        help
            The server address where the PowerRune update files are stored

    config OTA_TIMEOUT
        int "Time limit(MS) for OTA task"
        default 20000

    config ESPNOW_TIMEOUT
        int "Time limit(MS) for ESPNOW operations"
        default 300

    config BEACON_TIMEOUT
        int "Time limit(MS) for Beacon detection"
        default 15000

    config ESPNOW_PMK
        string "ESPNOW primary master key"
        default "z9BJ2ULDYA7vCxoM"
        help
            ESPNOW primary master for the example to use. The length of ESPNOW primary master must be 16 bytes.

    config ESPNOW_LMK
        string "ESPNOW local master key"
        default "rv29b0wTgFb8Zozi"
        help
            ESPNOW local master for the example to use. The length of ESPNOW local master must be 16 bytes.

    config ESPNOW_CHANNEL
        int "Channel"
        default 1
        range 0 14
        help
            The channel on which sending and receiving ESPNOW data.

    config DEFAULT_UPDATE_FILE
        string "PowerRune Update Filename"
        default "%sPowerRune24-%i_latest.bin"
        help
            %i represents the driver board type (0:ARMOUR, 1:RLOGO, 2:MOTORCTL)

    config DEFAULT_UPDATE_SSID
        string "PowerRune Update Default WiFi Name"
        default "3SE-120"

    config DEFAULT_UPDATE_PWD
        string "PowerRune Update Default WiFi Password"
        default "roboclub"

    config PR_NVS_NAMESPACE
        string "NVS Namespace for PowerRune"
        default "PowerRune"
        help
            PR Namespace for NVS

endmenu
```

## PowerRune24-RLogo/main/Kconfig.projbuild
```kconfig
menu "PowerRune Project Configuration"

    orsource "$IDF_PATH/examples/common_components/env_caps/$IDF_TARGET/Kconfig.env_caps"

    config POWERRUNE_TYPE
        int "PowerRune Driver Board Type"
        default 1
        help
            PowerRune driver board type (0:ARMOUR, 1:RLOGO, 2:MOTORCTL)

    config DEFAULT_UPDATE_URL
        string "PowerRune Update Server Address"
        default "https://gitlab.seu.edu.cn/ch/pr-ota-bin/-/raw/main/"
        help
            The server address where the PowerRune update files are stored

    config OTA_TIMEOUT
        int "Time limit(MS) for OTA task"
        default 20000

    config ESPNOW_TIMEOUT
        int "Time limit(MS) for ESPNOW operations"
        default 300

    config BEACON_TIMEOUT
        int "Time limit(MS) for Beacon detection"
        default 15000

    config ESPNOW_PMK
        string "ESPNOW primary master key"
        default "z9BJ2ULDYA7vCxoM"
        help
            ESPNOW primary master for the example to use. The length of ESPNOW primary master must be 16 bytes.

    config ESPNOW_LMK
        string "ESPNOW local master key"
        default "rv29b0wTgFb8Zozi"
        help
            ESPNOW local master for the example to use. The length of ESPNOW local master must be 16 bytes.

    config ESPNOW_CHANNEL
        int "Channel"
        default 1
        range 0 14
        help
            The channel on which sending and receiving ESPNOW data.

    config DEFAULT_UPDATE_FILE
        string "PowerRune Update Filename"
        default "%sPowerRune24-%i_latest.bin"
        help
            %i represents the driver board type (0:ARMOUR, 1:RLOGO, 2:MOTORCTL)

    config DEFAULT_UPDATE_SSID
        string "PowerRune Update Default WiFi Name"
        default "3SE-120"

    config DEFAULT_UPDATE_PWD
        string "PowerRune Update Default WiFi Password"
        default "roboclub"

    config PR_NVS_NAMESPACE
        string "NVS Namespace for PowerRune"
        default "PowerRune"
        help
            PR Namespace for NVS

endmenu
```
